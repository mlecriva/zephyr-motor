## dts/bindings/motor_control/zephyr,motor-control.yaml
```yaml
# Copyright (c) 2026 Rtone
# Copyright (c) 2026 Mathis Lécrivain <lecrivain.mathis@gmail.com>
# SPDX-License-Identifier: Apache-2.0

description: |
  Closed speed loop over a motor and the sensor serving its speed.

  Every control-period-ms, the setpoint is ramped toward the requested
  speed, then a speed PID turns the error into the signed voltage applied
  to the motor, in per-mille of the supply. There is no inner current
  loop.

  Gains and bounds are integers scaled by 1000 or 1000000 only because
  devicetree has no floating-point type; the controller converts them to
  floats at init.

compatible: "zephyr,motor-control"

include: base.yaml

properties:
  motor:
    type: phandle
    required: true
    description: |
      The zephyr,motor node driven, through the generic motor API.

  motor-sensor:
    type: phandle
    required: true
    description: |
      The sensor serving the speed of that motor as SENSOR_CHAN_RPM,
      signed by the direction, typically its zephyr,motor-feedback child.

  control-period-ms:
    type: int
    default: 10
    description: |
      Regulation period in milliseconds, also the PID period. Every
      controller shares one work queue thread: below 2 ms, check that the
      tick of all of them stays well within the period.

  speed-pid-kp-micro:
    type: int
    default: 0
    description: |
      Proportional gain × 1000000, in per-mille of the supply voltage per
      RPM of error.

  speed-pid-ki-micro:
    type: int
    default: 0
    description: |
      Integral gain × 1000000, in per-mille of the supply voltage per RPM
      of error and per second.

  speed-pid-kd-micro:
    type: int
    default: 0
    description: |
      Derivative gain × 1000000, in per-mille of the supply voltage per
      RPM/s of error change.

  speed-pid-integral-min-milli:
    type: int
    default: -1000000
    description: |
      Lower bound of the integral accumulator × 1000, in per-mille of the
      supply voltage.

  speed-pid-integral-max-milli:
    type: int
    default: 1000000
    description: |
      Upper bound of the integral accumulator × 1000, in per-mille of the
      supply voltage.

  output-min-milli:
    type: int
    default: -1000
    description: |
      Lower bound of the voltage applied, in per-mille of the supply; the
      sign sets the direction, -1000 is full reverse.

  output-max-milli:
    type: int
    default: 1000
    description: |
      Upper bound of the voltage applied, in per-mille of the supply; 1000
      is full forward.

  ramp-acceleration-rpm-per-s:
    type: int
    required: true
    description: |
      Slew rate of the setpoint while its magnitude grows, away from 0, in
      RPM/s. Also the deceleration when ramp-deceleration-rpm-per-s is
      unset. No default: it depends on the motor and its load.

  ramp-deceleration-rpm-per-s:
    type: int
    description: |
      Slew rate of the setpoint while its magnitude shrinks toward 0, in
      RPM/s. Unset uses ramp-acceleration-rpm-per-s. A lower value keeps
      the braking of a loaded rotor gentle: an abrupt setpoint drop
      saturates the PID to reverse voltage.
```

## dts/bindings/pwm_bridge/pwm-bridge-device.yaml
```yaml
# Copyright (c) 2026 Rtone
# Copyright (c) 2026 Mathis Lécrivain <lecrivain.mathis@gmail.com>
# SPDX-License-Identifier: Apache-2.0

description: |
  Common properties of a pwm_bridge output stage.

include: base.yaml

properties:
  pwm-frequency-hz:
    type: int
    required: true
    description: |
      Switching frequency of the carrier, in Hz. Shared by every leg of the
      bridge and fixed at init.

  deadtime-ns:
    type: int
    required: true
    description: |
      Dead-time inserted between the falling edge of one switch of a leg and
      the rising edge of the other, in nanoseconds. Prevents shoot-through.

  sync-trigger-enable:
    type: boolean
    description: |
      Drive the period-synchronous trigger from the carrier's update event, 
      e.g. to synchronize an ADC measurement to the carrier period.
      Unset leaves it inactive.

  break-input:
    type: boolean
    description: |
      Wire the hardware cut-off input to the output stage. On assertion the
      hardware disables every switch with no software involvement.
      Unset leaves it inactive.
```

## dts/bindings/pwm_bridge/st,stm32-pwm-bridge.yaml
```yaml
# Copyright (c) 2026 Rtone
# Copyright (c) 2026 Mathis Lécrivain <lecrivain.mathis@gmail.com>
# SPDX-License-Identifier: Apache-2.0

description: |
  STM32 bridge output stage (advanced-control timer).

  Drives one to four half-bridge legs from a single advanced-control timer
  (TIM1 or TIM8).

  The timer is owned exclusively by this driver. Any sibling child of the same
  timers node must stay disabled, or the build fails.

compatible: "st,stm32-pwm-bridge"

include: [pinctrl-device.yaml, pwm-bridge-device.yaml]

properties:
  pinctrl-0:
    required: true
    description: |
      Phase pins: CHx and CHxN of every channel listed in st,leg-channels, plus
      BKIN when break-input is set.

  pinctrl-names:
    required: true
    const: ["default"]
    description: |
      The driver applies PINCTRL_STATE_DEFAULT at init, which only this name
      maps to. Any other name fails the build or the device init.

  st,leg-channels:
    type: array
    required: true
    description: |
      Timer channels carrying the legs, in leg order.
      e.g. <1 2 3> makes channel 1 the U leg, 2 the V leg, 3 the W leg. 

  deadtime-ns:
    description: |
      Encoded into the timer DTG field at init, rounding up.

  sync-trigger-enable:
    description: |
      Drives TRGO2 internal hardware trigger from the update event.

  break-input:
    description: |
      BKIN, active low and unfiltered. The BKIN pin must be listed in
      pinctrl-0.
```

## lib/Kconfig
```kconfig
# Copyright (c) 2026 Rtone
# Copyright (c) 2026 Mathis Lécrivain <lecrivain.mathis@gmail.com>
# SPDX-License-Identifier: Apache-2.0

menu "Libraries"
rsource "pid/Kconfig"
endmenu
```

## lib/pid/Kconfig
```kconfig
# Copyright (c) 2026 Rtone
# Copyright (c) 2026 Mathis Lécrivain <lecrivain.mathis@gmail.com>
# SPDX-License-Identifier: Apache-2.0

config PID
	bool "PID regulator library"
	imply FPU if CPU_HAS_FPU
	help
	  Enable a PID regulator with output saturation and back-calculation
	  anti-windup, one state per handle. Floating-point (float32)
	  implementation: FPU is implied on SoCs that have one, and the
	  application may still disable it.

if PID

module = PID
module-str = pid
source "subsys/logging/Kconfig.template.log_config"

endif # PID
```

## lib/ramp/Kconfig
```kconfig
# Copyright (c) 2026 Rtone
# Copyright (c) 2026 Mathis Lécrivain <lecrivain.mathis@gmail.com>
# SPDX-License-Identifier: Apache-2.0

config RAMP
	bool "Ramp library"
	imply FPU if CPU_HAS_FPU
	help
	  Enable a ramp: a slew-rate limiter moving an output toward a
	  target once per step, with separate rates away from and toward 0,
	  one state per handle. Floating-point (float32) implementation:
	  FPU is implied on SoCs that have one, and the application may
	  still disable it.
```

## subsys/Kconfig
```kconfig
# Copyright (c) 2026 Rtone
# Copyright (c) 2026 Mathis Lécrivain <lecrivain.mathis@gmail.com>
# SPDX-License-Identifier: Apache-2.0

menu "Subsystems"
rsource "motor_control/Kconfig"
endmenu
```

## subsys/motor_control/Kconfig
```kconfig
# Copyright (c) 2026 Rtone
# Copyright (c) 2026 Mathis Lécrivain <lecrivain.mathis@gmail.com>
# SPDX-License-Identifier: Apache-2.0

menuconfig MOTOR_CONTROL
	bool "Motor control"
	default y
	depends on DT_HAS_ZEPHYR_MOTOR_CONTROL_ENABLED
	depends on MOTOR
	depends on SENSOR
	select PID
	select RAMP
	help
	  Enable the "zephyr,motor-control" devices: a closed speed loop
	  (setpoint ramp and speed PID) over a "zephyr,motor" node and the
	  sensor serving its speed, run from a dedicated work queue.

if MOTOR_CONTROL

module = MOTOR_CONTROL
module-str = motor_control
source "subsys/logging/Kconfig.template.log_config"

config MOTOR_CONTROL_INIT_PRIORITY
	int "Motor control init priority"
	default 91
	help
	  Must stay strictly above the priority of the motor and of its speed
	  sensor, SENSOR_INIT_PRIORITY for a zephyr,motor-feedback child.

config MOTOR_CONTROL_WORKQ_STACK_SIZE
	int "Motor control work queue stack size"
	default 1024
	help
	  Stack of the thread running the regulation tick of every
	  controller: a sensor read, a PID step and a motor command.

config MOTOR_CONTROL_WORKQ_PRIORITY
	int "Motor control work queue thread priority"
	default -2
	help
	  A cooperative (negative) priority keeps application threads from
	  delaying the regulation tick. The default leaves -1 to system
	  services that must preempt it.

config MOTOR_CONTROL_SHELL
	bool "Motor control shell commands"
	default y
	depends on SHELL
	help
	  Enable the "mc" shell command tree (list, start, stop, reset,
	  target, speed) over every "zephyr,motor-control" node, to run
	  the speed loop and tune its gains. Printing the gains needs
	  CBPRINTF_FP_SUPPORT.

endif # MOTOR_CONTROL
```
