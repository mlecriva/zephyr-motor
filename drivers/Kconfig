## drivers/Kconfig
```kconfig
# Copyright (c) 2026 Rtone
# Copyright (c) 2026 Mathis Lécrivain <lecrivain.mathis@gmail.com>
# SPDX-License-Identifier: Apache-2.0

menu "Drivers"
rsource "pwm_bridge/Kconfig"
endmenu
```

## drivers/bldc_adc/Kconfig
```kconfig
# Copyright (c) 2026 Rtone
# Copyright (c) 2026 Mathis Lécrivain <lecrivain.mathis@gmail.com>
# SPDX-License-Identifier: Apache-2.0

menuconfig BLDC_ADC
	bool "PWM-synchronized ADC acquisition drivers"
	help
	  Enable drivers for the bldc_adc device class.

if BLDC_ADC

module = BLDC_ADC
module-str = bldc_adc
source "subsys/logging/Kconfig.template.log_config"

config BLDC_ADC_INIT_PRIORITY
	int "PWM-synchronized ADC driver init priority"
	default 51
	help
	  Must stay strictly below the priority of any consumer, which reads or
	  registers its sample handler at its own init. A read waits for the
	  bridge trigger, so that consumer must also init after
	  PWM_BRIDGE_INIT_PRIORITY.

rsource "Kconfig.stm32"

endif # BLDC_ADC
```

## drivers/bldc_adc/Kconfig.stm32
```kconfig
# Copyright (c) 2026 Rtone
# Copyright (c) 2026 Mathis Lécrivain <lecrivain.mathis@gmail.com>
# SPDX-License-Identifier: Apache-2.0

config BLDC_ADC_STM32
	bool "STM32 three-channel PWM-synchronized ADC acquisition"
	default y
	depends on DT_HAS_ST_STM32_BLDC_ADC_ENABLED
	select USE_STM32_LL_ADC
	help
	  Enable the three-channel acquisition driver for STM32 ADCs. Runs an
	  injected conversion group triggered once per PWM period by a
	  three-phase bridge, and reports raw counts plus the measured VREF+.

if BLDC_ADC_STM32

config BLDC_ADC_STM32_READ_TIMEOUT_US
	int "adc read per-call deadline (us)"
	default 2000
	help
	  How long bldc_adc_read() waits for the next triggered sequence
	  before returning -ETIMEDOUT.

endif # BLDC_ADC_STM32
```

## drivers/bldc_hall/Kconfig
```kconfig
# Copyright (c) 2026 Rtone
# Copyright (c) 2026 Mathis Lécrivain <lecrivain.mathis@gmail.com>
# SPDX-License-Identifier: Apache-2.0

menuconfig BLDC_HALL
	bool "Three-line Hall sensor drivers"
	help
	  Enable drivers for the bldc_hall device class (drivers/bldc_hall.h).

if BLDC_HALL

module = BLDC_HALL
module-str = bldc_hall
source "subsys/logging/Kconfig.template.log_config"

config BLDC_HALL_INIT_PRIORITY
	int "Three-line Hall driver init priority"
	default 51
	help
	  Must stay strictly below the priority of any consumer, which checks
	  this device ready and registers its edge handler at its own init.

rsource "Kconfig.stm32"

endif # BLDC_HALL
```

## drivers/bldc_hall/Kconfig.stm32
```kconfig
# Copyright (c) 2026 Rtone
# Copyright (c) 2026 Mathis Lécrivain <lecrivain.mathis@gmail.com>
# SPDX-License-Identifier: Apache-2.0

config BLDC_HALL_STM32
	bool "STM32 timer-XOR Hall acquisition"
	default y
	depends on DT_HAS_ST_STM32_BLDC_HALL_XOR_ENABLED
	select PINCTRL
	select GPIO
	select USE_STM32_LL_TIM
	help
	  Implements the bldc_hall device class (drivers/bldc_hall.h) through
	  the timer hardware XOR and slave-mode reset: every commutation edge
	  is timed, so six edges per electrical revolution.
```

## drivers/motor/Kconfig
```kconfig
# Copyright (c) 2026 Rtone
# Copyright (c) 2026 Mathis Lécrivain <lecrivain.mathis@gmail.com>
# SPDX-License-Identifier: Apache-2.0

menuconfig MOTOR
	bool "Motor drivers"
	help
	  Enable drivers for the motor device class (drivers/motor.h).

if MOTOR

module = MOTOR
module-str = motor
source "subsys/logging/Kconfig.template.log_config"

config MOTOR_INIT_PRIORITY
	int "Motor driver init priority"
	default 60
	help
	  Must stay strictly above the priority of every device a motor binds.
	  Must also stay strictly below the priority of any consumer, such as
	  SENSOR_INIT_PRIORITY for a zephyr,motor-feedback child.

config MOTOR_SHELL
	bool "Motor shell commands"
	default y
	depends on SHELL
	depends on DT_HAS_ZEPHYR_MOTOR_ENABLED
	help
	  Enable the "motor" shell command tree (list, start, stop, voltage)
	  over every "zephyr,motor" node, through the generic motor API only.
	  Implementations may add their own subcommands to it.

rsource "Kconfig.bldc_6step_bridge_hall"
rsource "feedback/Kconfig"

endif # MOTOR
```

## drivers/motor/Kconfig.bldc_6step_bridge_hall
```kconfig
# Copyright (c) 2026 Rtone
# Copyright (c) 2026 Mathis Lécrivain <lecrivain.mathis@gmail.com>
# SPDX-License-Identifier: Apache-2.0

config MOTOR_BLDC_6STEP_BRIDGE_HALL
	bool "6-step BLDC motor on pwm_bridge and bldc_hall"
	default y
	depends on DT_HAS_ZEPHYR_BLDC_6STEP_BRIDGE_HALL_ENABLED
	select PWM_BRIDGE
	select BLDC_HALL
	imply BLDC_ADC
	help
	  Enable the 6-step BLDC motor driver with Hall sensors. Commutates a
	  three-leg pwm_bridge from the edges of a bldc_hall device, and can
	  bind a bldc_adc sampler synchronized to the same bridge, all named
	  by phandle. Reports the shaft speed and angle from the Hall edges,
	  and the phase currents from the sampler, all raw. Holds no vendor
	  code.

if MOTOR_BLDC_6STEP_BRIDGE_HALL

config MOTOR_BLDC_6STEP_BRIDGE_HALL_ADC_CALIB_SAMPLES
	int "Zero-current calibration samples"
	default 16
	range 1 32
	help
	  Number of conversions averaged per phase during the boot
	  zero-current offset calibration, when an adc is bound. Higher values
	  reduce the residual offset noise at the cost of a longer boot
	  calibration. Only the offset is averaged: the phase currents
	  reported afterwards are single samples.

endif # MOTOR_BLDC_6STEP_BRIDGE_HALL
```

## drivers/motor/feedback/Kconfig
```kconfig
# Copyright (c) 2026 Rtone
# Copyright (c) 2026 Mathis Lécrivain <lecrivain.mathis@gmail.com>
# SPDX-License-Identifier: Apache-2.0

config MOTOR_FEEDBACK
	bool "Generic motor feedback sensor"
	default y
	depends on DT_HAS_ZEPHYR_MOTOR_FEEDBACK_ENABLED
	select SENSOR
	help
	  Enable the "zephyr,motor-feedback" sensor, a child of a
	  "zephyr,motor" node. It serves the raw feedback of its parent
	  (shaft angle and speed, and the phase currents when measured)
	  through the Zephyr sensor API, using only motor_get_feedback() from
	  the generic motor API. Initializes at SENSOR_INIT_PRIORITY, which
	  must stay above MOTOR_INIT_PRIORITY.
```

## drivers/pwm_bridge/Kconfig
```kconfig
# Copyright (c) 2026 Rtone
# Copyright (c) 2026 Mathis Lécrivain <lecrivain.mathis@gmail.com>
# SPDX-License-Identifier: Apache-2.0

menuconfig PWM_BRIDGE
	bool "Bridge output stage drivers"
	help
	  Enable drivers for the bridge output stage device class
	  (drivers/pwm_bridge.h).

if PWM_BRIDGE

module = PWM_BRIDGE
module-str = pwm_bridge
source "subsys/logging/Kconfig.template.log_config"

config PWM_BRIDGE_INIT_PRIORITY
	int "Bridge output stage init priority"
	default 50
	help
	  This class does not select PWM, so it cannot inherit
	  PWM_INIT_PRIORITY. Kept at the same value. Must stay strictly below
	  the priority of any consumer, which reads the bridge capabilities at
	  its own init.

rsource "Kconfig.stm32"

endif # PWM_BRIDGE
```

## drivers/pwm_bridge/Kconfig.stm32
```kconfig
# Copyright (c) 2026 Rtone
# Copyright (c) 2026 Mathis Lécrivain <lecrivain.mathis@gmail.com>
# SPDX-License-Identifier: Apache-2.0

config PWM_BRIDGE_STM32
	bool "STM32 bridge output stage"
	default y
	depends on DT_HAS_ST_STM32_PWM_BRIDGE_ENABLED
	select PINCTRL
	select RESET
	select USE_STM32_LL_TIM
	help
	  Enable the bridge output stage driver for STM32 advanced-control
	  timers (TIM1/TIM8). Drives one to four half-bridge legs with hardware
	  dead-time on a center-aligned carrier, and commits the state of every
	  leg atomically through a commutation event.
```

## dts/bindings/bldc_adc/bldc-adc-device.yaml
```yaml
# Copyright (c) 2026 Rtone
# Copyright (c) 2026 Mathis Lécrivain <lecrivain.mathis@gmail.com>
# SPDX-License-Identifier: Apache-2.0

description: |
  Common properties of a bldc_adc three-channel acquisition device.

include: base.yaml

properties:
  pwm:
    type: phandle
    required: true
    description: |
      The bridge whose sync trigger clocks this acquisition, once per PWM
      period. Its trigger output must be enabled, or this device never
      converts.

  channels:
    type: array
    required: true
    description: |
      The three ADC channel numbers, in acquisition order. That order is the
      order the driver reports results in, and it is fixed for the lifetime of
      the device.

  frontend-settle-ms:
    type: int
    default: 50
    description: |
      Uptime, in milliseconds, to reach before any reference-dependent
      measurement, so the reference and the analog front-end settle.
      Measured from boot rather than per device, so several instances on the
      same supply pay it once.
```

## dts/bindings/bldc_adc/st,stm32-bldc-adc.yaml
```yaml
# Copyright (c) 2026 Rtone
# Copyright (c) 2026 Mathis Lécrivain <lecrivain.mathis@gmail.com>
# SPDX-License-Identifier: Apache-2.0

description: |
  STM32 three-channel PWM-synchronized ADC acquisition.

  Runs a three-rank injected conversion group on one ADC, triggered in hardware
  once per PWM period by the TRGO2 of the bridge named in the pwm property.
  The three conversions therefore always land at the same point in the
  switching cycle.

compatible: "st,stm32-bldc-adc"

include: [bldc-adc-device.yaml]
```

## dts/bindings/bldc_hall/bldc-hall-device.yaml
```yaml
# Copyright (c) 2026 Rtone
# Copyright (c) 2026 Mathis Lécrivain <lecrivain.mathis@gmail.com>
# SPDX-License-Identifier: Apache-2.0

description: |
  Common properties of a bldc_hall three-line Hall acquisition device.

include: base.yaml

properties:
  hall-gpios:
    type: phandle-array
    required: true
    description: |
      The three Hall sensor lines, in U/V/W order: this order alone defines
      the phases.
```

## dts/bindings/bldc_hall/st,stm32-bldc-hall-xor.yaml
```yaml
# Copyright (c) 2026 Rtone
# Copyright (c) 2026 Mathis Lécrivain <lecrivain.mathis@gmail.com>
# SPDX-License-Identifier: Apache-2.0

description: |
  STM32 Hall acquisition through the timer hardware XOR (TI1S).

  The three Hall lines feed CH1/CH2/CH3 of one timer. Their XOR resets the
  counter on every edge and a capture latches the elapsed interval: six timed
  edges per electrical revolution.

compatible: "st,stm32-bldc-hall-xor"

include: [pinctrl-device.yaml, bldc-hall-device.yaml]

properties:
  pinctrl-0:
    required: true
    description: |
      CH1, CH2 and CH3 of the parent timer, one pin per Hall line. Any line
      may go to any channel and the listing order is free: hall-gpios alone
      defines U/V/W.

  pinctrl-names:
    required: true
    const: ["default"]
    description: |
      The driver applies PINCTRL_STATE_DEFAULT at init, which only this name
      maps to. Any other name fails the build or the device init.

  hall-gpios:
    description: |
      The same three pins as pinctrl-0, in U/V/W order: this order alone
      defines the phases. The driver reads the Hall state from their input
      registers, which stay valid while the pins are muxed to the timer.

      Levels are read raw and the pins are set up by pinctrl, so every flag
      cell must be 0 (the build fails otherwise). Put any pull in pinctrl-0.
```

## dts/bindings/motor/zephyr,bldc-6step-bridge-hall.yaml
```yaml
# Copyright (c) 2026 Rtone
# Copyright (c) 2026 Mathis Lécrivain <lecrivain.mathis@gmail.com>
# SPDX-License-Identifier: Apache-2.0

description: |
  6-step BLDC motor on a pwm_bridge and a bldc_hall device.

  Commutates a three-leg pwm_bridge from the edges of a bldc_hall device,
  and can bind a bldc_adc sampler synchronized to the same bridge, all named
  by phandle. The node owns no hardware of its own.

compatible: "zephyr,bldc-6step-bridge-hall"

include: zephyr,motor.yaml

properties:
  pwm:
    type: phandle
    required: true
    description: |
      The pwm_bridge driving the three motor phases. It must drive exactly
      three legs and support the HI_Z, PWM and FORCE_LOW leg states.

  hall:
    type: phandle
    required: true
    description: |
      The bldc_hall device reading the Hall sensors of this motor. Each of
      its edges triggers a commutation.

  adc:
    type: phandle
    description: |
      The bldc_adc sampling the three phase currents of this motor, its
      channels in U/V/W order. It must be synchronized to the bridge named
      in pwm, or the build fails. Unset leaves the motor without current
      sensing.

  shunt-resistance-uohm:
    type: int
    description: |
      Phase-current shunt resistance, in microohms. Required with adc, to
      convert its counts to milliamps with current-gain-milli.

  current-gain-milli:
    type: int
    description: |
      Current-sense amplifier gain, scaled by 1000 (e.g. 2100 = gain 2.10).
      Required with adc.

  motor-pole-pairs:
    type: int
    default: 1
    description: |
      Rotor pole pairs. The Hall sensors see electrical revolutions, the
      feedback reports the shaft: one mechanical revolution every
      motor-pole-pairs electrical ones.
```

## dts/bindings/motor/zephyr,motor-feedback.yaml
```yaml
# Copyright (c) 2026 Rtone
# Copyright (c) 2026 Mathis Lécrivain <lecrivain.mathis@gmail.com>
# SPDX-License-Identifier: Apache-2.0

description: |
  Feedback of a motor, as a sensor.

  Child of a zephyr,motor node. Serves the shaft angle and speed its parent
  reports, raw, as SENSOR_CHAN_ROTATION and SENSOR_CHAN_RPM, and the phase
  currents, when the motor measures them, as the private channels of
  drivers/sensor/motor_feedback.h.

compatible: "zephyr,motor-feedback"

include: [sensor-device.yaml]
```

## dts/bindings/motor/zephyr,motor.yaml
```yaml
# Copyright (c) 2026 Rtone
# Copyright (c) 2026 Mathis Lécrivain <lecrivain.mathis@gmail.com>
# SPDX-License-Identifier: Apache-2.0

description: |
  Common compatible of a motor driven through the motor API.

  A motor node lists its implementation compatible first and this one
  second, so consumers enumerate motors without knowing the implementation.
  Each implementation binding includes this one and adds its own properties.

compatible: "zephyr,motor"

include: base.yaml
```
